## config/boards/shields/mykbd/Kconfig.defconfig
```kconfig
if SHIELD_MYKBD

config ZMK_KEYBOARD_NAME
    default "mykbd"

config LED
    default y

config LED_LOCK_STATUS
    bool "Enable LED lock indicators, such as Caps lock, Num Lock ..."
    default n

if ZMK_BACKLIGHT

config PWM
    default y

config LED_PWM
    default y

endif # ZMK_BACKLIGHT

endif # SHIELD_MYKBD
```

## config/west.yml
```yaml
manifest:
  remotes:
    - name: zmkfirmware
      url-base: https://github.com/zmkfirmware
    - name: caksoylar  # for MCU RGB LED control
      url-base: https://github.com/caksoylar 
  projects:
    - name: zmk
      remote: zmkfirmware
      revision: main
      import: app/west.yml
    - name: zmk-rgbled-widget  # for MCU RGB LED control
      remote: caksoylar
      revision: main
  self:
    path: config
```
